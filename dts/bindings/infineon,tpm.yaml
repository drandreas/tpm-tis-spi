## dts/bindings/infineon,tpm.yaml
```yaml
description: TCG standard compliant TPM

compatible: "infineon,tpm"

include: spi-device.yaml

properties:
  reset-gpios:
    type: phandle-array
    required: false
    description: The pin is asserted for 10ms during boot to reset the TPM.

  cs-gpios:
    type: phandle-array
    required: false
    description: The pin is asserted as CS instead of the HW CS handling.
```

## zephyr/Kconfig
```kconfig
config TPM_TIS_SPI
	bool "TCG standard compliant TPM driver"
	depends on SPI
	default n
	help
		Enable driver for TCG standard compliant TPM.
```
